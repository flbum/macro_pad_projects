/*
 * Copyright (c) 2026
 *
 * SPDX-License-Identifier: MIT
 */

#include "velociraptor36.dtsi"

&default_transform {
    col-offset = <5>;
};

&kscan0 {
    /* Cols: P0.24, P1.00, P0.11, P1.04, P1.06 */
    col-gpios
        = <&pro_micro 5 GPIO_ACTIVE_HIGH>
        , <&pro_micro 6 GPIO_ACTIVE_HIGH>
        , <&pro_micro 7 GPIO_ACTIVE_HIGH>
        , <&pro_micro 8 GPIO_ACTIVE_HIGH>
        , <&pro_micro 9 GPIO_ACTIVE_HIGH>
        ;
};

&right_encoder {
    status = "okay";
    /* Swap A/B here too if right encoder only works one way. */
    a-gpios = <&pro_micro 19 (GPIO_ACTIVE_HIGH | GPIO_PULL_UP)>;
    b-gpios = <&pro_micro 18 (GPIO_ACTIVE_HIGH | GPIO_PULL_UP)>;
};

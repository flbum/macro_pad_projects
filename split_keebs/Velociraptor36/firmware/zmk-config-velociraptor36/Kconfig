## split_keebs/Velociraptor36/firmware/zmk-config-velociraptor36/boards/shields/velociraptor36/Kconfig.defconfig
```kconfig
if SHIELD_VELOCIRAPTOR36_DONGLE

config ZMK_KEYBOARD_NAME
    default "Velociraptor36"

config ZMK_SPLIT_ROLE_CENTRAL
    default y

config ZMK_SPLIT
    default y

config ZMK_SPLIT_BLE_CENTRAL_PERIPHERALS
    default 2

config BT_MAX_CONN
    default 7

config BT_MAX_PAIRED
    default 7

endif

if SHIELD_VELOCIRAPTOR36_LEFT || SHIELD_VELOCIRAPTOR36_RIGHT || SHIELD_VELOCIRAPTOR36_DONGLE

config ZMK_SPLIT
    default y

endif
```

## split_keebs/Velociraptor36/firmware/zmk-config-velociraptor36/boards/shields/velociraptor36/Kconfig.shield
```kconfig
config SHIELD_VELOCIRAPTOR36_LEFT
    def_bool $(shields_list_contains,velociraptor36_left)

config SHIELD_VELOCIRAPTOR36_RIGHT
    def_bool $(shields_list_contains,velociraptor36_right)

config SHIELD_VELOCIRAPTOR36_DONGLE
    def_bool $(shields_list_contains,velociraptor36_dongle)
```
